/*
 * The totem keymap is the toucan keymap with two extra "outer pinky" SW16
 * keys filled in as &none. We define those macros here, then include the
 * single source of truth from config/. Editor only sees toucan; firmware
 * gets a 38-binding keymap that matches upstream's totem matrix transform.
 */
#define SW16_LEFT  &none
#define SW16_RIGHT &none
#include "../../../config/toucan36.keymap"
