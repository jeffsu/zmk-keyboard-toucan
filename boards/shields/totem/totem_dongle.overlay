#include "totem.dtsi"

/*
 * The dongle is the central; it has no keys. ZMK still references
 * DT_CHOSEN(zmk_kscan), so swap kscan0 for an inert kscan-composite
 * that has no children and never reports any events.
 */
/delete-node/ &kscan0;

/ {
    chosen {
        zmk,kscan = &kscan_dongle;
    };

    kscan_dongle: kscan_dongle {
        compatible = "zmk,kscan-composite";
        rows = <4>;
        columns = <10>;
    };
};
